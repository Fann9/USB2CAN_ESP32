## sdkconfig.defaults
```kconfig
CONFIG_IDF_TARGET="esp32"
CONFIG_ESP_CONSOLE_UART_DEFAULT=y
CONFIG_ESP_CONSOLE_UART_BAUDRATE=115200
CONFIG_ESPTOOLPY_MONITOR_BAUD=115200
CONFIG_FREERTOS_HZ=1000
# CONFIG_FREERTOS_UNICORE is not set
CONFIG_CTSHELL_PORT_CUSTOM=y
CONFIG_CTSHELL_USE_BUILTIN_CMDS=y
CONFIG_CTSHELL_PROMPT="al1s> "
CONFIG_CTSHELL_HISTORY_SIZE=8
CONFIG_CTSHELL_PRINTF_BUF_SIZE=256
```
